## layers/meta-balena-edison/conf/layer.conf
```bitbake
BBPATH .= ":${LAYERDIR}"

BBFILES += "${LAYERDIR}/recipes-*/*/*.bb \
            ${LAYERDIR}/recipes-*/*/*.bbappend"

BBFILE_COLLECTIONS += "balena-edison"
BBFILE_PATTERN_balena-edison := "^${LAYERDIR}/"
BBFILE_PRIORITY_balena-edison = "1337"

DISTRO_FEATURES_append_edison = " bluez5"

LAYERSERIES_COMPAT_edison = "warrior"
LAYERSERIES_COMPAT_balena-edison = "warrior"

# Leave user namespacing disabled at runtime to match upstream
DISTRO_FEATURES_append_edison = " disable-user-ns"
```

## layers/meta-resin-edison/conf/layer.conf
```bitbake
BBPATH .= ":${LAYERDIR}"

BBFILES += "${LAYERDIR}/recipes-*/*/*.bb \
            ${LAYERDIR}/recipes-*/*/*.bbappend"

BBFILE_COLLECTIONS += "resin-edison"
BBFILE_PATTERN_resin-edison := "^${LAYERDIR}/"
BBFILE_PRIORITY_resin-edison = "1337"

DISTRO_FEATURES_append_edison = " bluez5"
```
